## CMakeLists.txt
```
cmake_minimum_required(VERSION 3.20.0)

find_package(Zephyr REQUIRED HINTS $ENV{ZEPHYR_BASE})
project(local_device_portal)

target_sources(app PRIVATE
  src/main.c
  src/credential_store.c
  src/portal_dns.c
  src/portal_http.c
  src/portal_render.c
  src/portal_state.c
  src/wifi_manager.c
)
```

## sample.yaml
```
sample:
  name: Wifi Device
  description: Captive Wi-Fi setup portal and local dashboard for ESP32 devices.
tests:
  sample.local_device_portal:
    build_only: true
    platform_allow:
      - esp32_devkitc/esp32/procpu
      - esp8684_devkitm
      - xiao_esp32c6/esp32c6/hpcore
    tags:
      - net
      - wifi
      - http
```

## prj.conf
```kconfig
# Wifi Device Zephyr firmware
#
# Wi-Fi/AP-STA configuration follows Zephyr's official
# samples/net/wifi/apsta_mode sample: AP mode stays enabled, DHCP serves setup
# clients, and STA mode connects through the separate STA interface.

CONFIG_MAIN_STACK_SIZE=3072
CONFIG_SYSTEM_WORKQUEUE_STACK_SIZE=3072
CONFIG_HEAP_MEM_POOL_SIZE=16384

CONFIG_LOG=y
CONFIG_PRINTK=y
CONFIG_ASSERT=y
CONFIG_HWINFO=y
CONFIG_REBOOT=y

# ESP32-WROOM rev v1.0 is reported by Zephyr as unsupported unless this is set.
CONFIG_ESP32_USE_UNSUPPORTED_REVISION=y

# Wi-Fi configuration, aligned with samples/net/wifi/apsta_mode/prj.conf.
CONFIG_WIFI=y
CONFIG_WIFI_NM=y
CONFIG_WIFI_USAGE_MODE_STA_AP=y

# Network configuration, aligned with samples/net/wifi/apsta_mode/prj.conf.
CONFIG_NETWORKING=y
CONFIG_NET_CONFIG_AUTO_INIT=n
CONFIG_NET_CONNECTION_MANAGER=y
CONFIG_NET_IPV4=y
CONFIG_NET_IPV6=n
CONFIG_NET_TCP=y
CONFIG_NET_UDP=y
CONFIG_NET_SOCKETS=y
CONFIG_NET_MGMT=y
CONFIG_NET_MGMT_EVENT=y
CONFIG_NET_MGMT_EVENT_INFO=y
CONFIG_NET_MGMT_EVENT_QUEUE_SIZE=10
CONFIG_NET_MGMT_EVENT_STACK_SIZE=4096
CONFIG_NET_PKT_RX_COUNT=48
CONFIG_NET_PKT_TX_COUNT=48
CONFIG_NET_BUF_RX_COUNT=64
CONFIG_NET_BUF_TX_COUNT=64
CONFIG_NET_MAX_CONTEXTS=24
CONFIG_NET_IF_MAX_IPV4_COUNT=2
CONFIG_NET_IF_MCAST_IPV4_ADDR_COUNT=3
CONFIG_NET_L2_ETHERNET=y
CONFIG_NET_L2_WIFI_MGMT=y
CONFIG_NET_SOCKETS_SERVICE_STACK_SIZE=4096
CONFIG_NET_TC_TX_COUNT=1
CONFIG_NET_TCP_TIME_WAIT_DELAY=0
CONFIG_NET_LOG=y
CONFIG_ZVFS_POLL_MAX=9

# DHCP server for setup AP clients.
CONFIG_NET_DHCPV4=y
CONFIG_NET_DHCPV4_SERVER=y
CONFIG_NET_DHCPV4_SERVER_ADDR_COUNT=8
CONFIG_NET_DHCPV4_SERVER_ICMP_PROBE_TIMEOUT=0

# Persistent credential storage.
CONFIG_FLASH=y
CONFIG_FLASH_MAP=y
CONFIG_NVS=y
CONFIG_SETTINGS=y
CONFIG_SETTINGS_NVS=y

# Hostname and local discovery.
CONFIG_NET_HOSTNAME_ENABLE=y
CONFIG_NET_HOSTNAME="wifi-device"
CONFIG_NET_HOSTNAME_DYNAMIC=y
CONFIG_NET_HOSTNAME_MAX_LEN=32

# Keep libc features available for string/page formatting.
CONFIG_NEWLIB_LIBC=y
CONFIG_MINIMAL_LIBC=n
```

## boards/esp32_devkitc_esp32_procpu.conf
```kconfig
# Board-specific settings for ESP-WROOM-32 style development boards.
#
# Keep this file available for ESP32-only overrides while the shared app config
# remains in prj.conf.

# Some ESP-WROOM-32 modules report ESP32 chip revision v1.0. Zephyr warns that
# this revision is unsupported unless the application explicitly opts in.
CONFIG_ESP32_USE_UNSUPPORTED_REVISION=y
```

## boards/esp8684_devkitm.conf
```kconfig
# Board-specific settings for ESP32-C2 class ESP8684-DevKitM boards.
#
# Keep this file available for ESP32-C2-only overrides while the shared app
# config remains in prj.conf.

# ESP32-C2 class parts have less SRAM than ESP-WROOM-32 and ESP32-C6 boards.
# Keep the same AP+STA portal behavior, but use smaller pools and production
# logging defaults for this board.
CONFIG_ASSERT=n
CONFIG_LOG=n
CONFIG_NET_LOG=n
CONFIG_NET_DHCPV4_SERVER_LOG_LEVEL_DBG=n

CONFIG_MAIN_STACK_SIZE=2048
CONFIG_SYSTEM_WORKQUEUE_STACK_SIZE=2048
CONFIG_NET_MGMT_EVENT_STACK_SIZE=2048
CONFIG_NET_SOCKETS_SERVICE_STACK_SIZE=2048
CONFIG_NET_TCP_WORKQ_STACK_SIZE=1536

CONFIG_NET_MGMT_EVENT_QUEUE_SIZE=4
CONFIG_NET_PKT_RX_COUNT=16
CONFIG_NET_PKT_TX_COUNT=16
CONFIG_NET_BUF_RX_COUNT=24
CONFIG_NET_BUF_TX_COUNT=24
CONFIG_NET_MAX_CONTEXTS=10
CONFIG_NET_IF_MCAST_IPV4_ADDR_COUNT=1
CONFIG_NET_DHCPV4_SERVER_ADDR_COUNT=2

CONFIG_ESP32_WIFI_STATIC_RX_BUFFER_NUM=4
CONFIG_ESP32_WIFI_DYNAMIC_RX_BUFFER_NUM=12
CONFIG_ESP32_WIFI_DYNAMIC_TX_BUFFER_NUM=12
CONFIG_ESP32_WIFI_RX_MGMT_BUF_NUM_DEF=3
CONFIG_ESP32_WIFI_MGMT_SBUF_NUM=12
CONFIG_ESP32_WIFI_TX_BA_WIN=2
CONFIG_ESP32_WIFI_RX_BA_WIN=2
```

## boards/xiao_esp32c6_esp32c6_hpcore.conf
```kconfig
# Board-specific settings for the Seeed Studio XIAO ESP32-C6.
#
# Keep this file available for XIAO ESP32-C6-only overrides while the shared app
# config remains in prj.conf.
```

## src/main.c
```c
#include "credential_store.h"
#include "portal_config.h"
#include "portal_http.h"
#include "portal_state.h"
#include "wifi_manager.h"

#include <zephyr/kernel.h>
#include <zephyr/logging/log.h>
#include <zephyr/net/hostname.h>

#include <string.h>

LOG_MODULE_REGISTER(local_device_portal, LOG_LEVEL_INF);

#define FW_MARKER "wifi-device-zephyr-2026-07-01"

int main(void)
{
	int ret;

	LOG_INF("Local Device Portal Zephyr starting");
	LOG_INF("FIRMWARE MARKER: %s", FW_MARKER);

	portal_state_init();
	credential_store_init();
	wifi_manager_init();

	ret = net_hostname_set(portal_state_host(), strlen(portal_state_host()));
	if (ret != 0) {
		LOG_WRN("hostname set failed: %d", ret);
	}

	LOG_INF("setup Wi-Fi: %s", portal_state_ap_ssid());
	LOG_INF("setup URL: http://%s/", PORTAL_AP_IP);
	LOG_INF("dashboard URL target: %s", portal_state_dashboard_url());

	ret = wifi_manager_start_ap();
	if (ret != 0) {
		LOG_ERR("setup AP failed: %d", ret);
		while (true) {
			k_sleep(K_SECONDS(1));
		}
	}

	portal_http_start();

	while (true) {
		k_sleep(K_SECONDS(1));
	}

	return 0;
}
```

## src/credential_store.c
```c
#include "credential_store.h"

#include "portal_config.h"

#include <zephyr/settings/settings.h>
#include <zephyr/logging/log.h>
#include <zephyr/sys/util.h>

#include <errno.h>
#include <stdbool.h>
#include <string.h>

LOG_MODULE_REGISTER(credential_store, LOG_LEVEL_INF);

static char saved_ssid[PORTAL_SSID_MAX + 1];
static char saved_pass[PORTAL_PASS_MAX + 1];

static int portal_settings_set(const char *key, size_t len_rd,
			       settings_read_cb read_cb, void *cb_arg)
{
	char *target = NULL;
	size_t target_len = 0;

	if (strcmp(key, "ssid") == 0) {
		target = saved_ssid;
		target_len = sizeof(saved_ssid);
	} else if (strcmp(key, "pass") == 0) {
		target = saved_pass;
		target_len = sizeof(saved_pass);
	} else {
		return -ENOENT;
	}

	size_t len = MIN(len_rd, target_len - 1);
	ssize_t rc = read_cb(cb_arg, target, len);
	if (rc < 0) {
		return (int)rc;
	}

	target[MIN((size_t)rc, target_len - 1)] = '\0';
	return 0;
}

SETTINGS_STATIC_HANDLER_DEFINE(portal_settings, "portal", NULL,
			       portal_settings_set, NULL, NULL);

void credential_store_init(void)
{
	int ret = settings_subsys_init();

	if (ret != 0 && ret != -EALREADY) {
		LOG_WRN("settings init failed: %d", ret);
	}

	ret = settings_load_subtree("portal");
	if (ret != 0) {
		LOG_WRN("settings load failed: %d", ret);
	}
}

void credential_store_save(const char *ssid, const char *pass)
{
	strncpy(saved_ssid, ssid, sizeof(saved_ssid) - 1);
	saved_ssid[sizeof(saved_ssid) - 1] = '\0';
	strncpy(saved_pass, pass, sizeof(saved_pass) - 1);
	saved_pass[sizeof(saved_pass) - 1] = '\0';

	settings_save_one("portal/ssid", saved_ssid, strlen(saved_ssid) + 1);
	settings_save_one("portal/pass", saved_pass, strlen(saved_pass) + 1);
}

void credential_store_clear(void)
{
	saved_ssid[0] = '\0';
	saved_pass[0] = '\0';
	settings_delete("portal/ssid");
	settings_delete("portal/pass");
}

const char *credential_store_ssid(void)
{
	return saved_ssid;
}

const char *credential_store_pass(void)
{
	return saved_pass;
}

bool credential_store_has_ssid(void)
{
	return saved_ssid[0] != '\0';
}
```

## src/credential_store.h
```c
#ifndef CREDENTIAL_STORE_H
#define CREDENTIAL_STORE_H

#include <stdbool.h>

void credential_store_init(void);
void credential_store_save(const char *ssid, const char *pass);
void credential_store_clear(void);

const char *credential_store_ssid(void);
const char *credential_store_pass(void);
bool credential_store_has_ssid(void);

#endif
```

## src/portal_config.h
```c
#ifndef PORTAL_CONFIG_H
#define PORTAL_CONFIG_H

#define PORTAL_PRODUCT_TITLE "Wifi Device"
#define PORTAL_AP_SSID_PREFIX "WifiDevice"
#define PORTAL_HOST_PREFIX   "wifi-device"
#define PORTAL_AP_PASS      "wifi-device-setup"
#define PORTAL_AP_IP        "192.168.4.1"
#define PORTAL_AP_MASK      "255.255.255.0"
#define PORTAL_DHCP_START_IP "192.168.4.2"

#define PORTAL_HTTP_PORT    80
#define PORTAL_DNS_PORT     53

#define PORTAL_MAX_NETS     24
#define PORTAL_SSID_MAX     32
#define PORTAL_PASS_MAX     64
#define PORTAL_REQ_MAX      2048
#define PORTAL_PAGE_MAX     12288
#define PORTAL_HOST_MAX     32
#define PORTAL_URL_MAX      64

#endif
```

## src/portal_dns.c
```c
#include "portal_dns.h"

#include "portal_config.h"

#include <zephyr/kernel.h>
#include <zephyr/logging/log.h>
#include <zephyr/net/socket.h>

#include <errno.h>
#include <stdint.h>
#include <string.h>

LOG_MODULE_REGISTER(portal_dns, LOG_LEVEL_INF);

static void dns_thread(void)
{
	int fd = zsock_socket(AF_INET, SOCK_DGRAM, IPPROTO_UDP);
	if (fd < 0) {
		LOG_ERR("dns socket failed: %d", errno);
		return;
	}

	/* Match the Arduino DNSServer behavior: listen on all IPv4 interfaces.
	 * Do not bind to a Zephyr Wi-Fi device name here. On ESP32 targets the
	 * AP/STA net_if mapping can differ by board, and bind-to-device can make
	 * the service appear to be listening while AP clients never reach it.
	 */
	struct sockaddr_in addr = { 0 };
	addr.sin_family = AF_INET;
	addr.sin_port = htons(PORTAL_DNS_PORT);
	addr.sin_addr.s_addr = htonl(INADDR_ANY);

	if (zsock_bind(fd, (struct sockaddr *)&addr, sizeof(addr)) < 0) {
		LOG_ERR("dns bind failed: %d", errno);
		zsock_close(fd);
		return;
	}

	LOG_INF("DNS captive responder listening on 0.0.0.0:%d", PORTAL_DNS_PORT);

	uint8_t query[512];
	uint8_t reply[576];

	while (true) {
		struct sockaddr_in peer;
		socklen_t peer_len = sizeof(peer);
		int len = zsock_recvfrom(fd, query, sizeof(query), 0,
					 (struct sockaddr *)&peer, &peer_len);
		if (len < 12) {
			continue;
		}

		LOG_INF("DNS query from %u.%u.%u.%u",
			(uint8_t)(ntohl(peer.sin_addr.s_addr) >> 24),
			(uint8_t)(ntohl(peer.sin_addr.s_addr) >> 16),
			(uint8_t)(ntohl(peer.sin_addr.s_addr) >> 8),
			(uint8_t)ntohl(peer.sin_addr.s_addr));

		memcpy(reply, query, len);
		reply[2] = 0x81;
		reply[3] = 0x80;
		reply[6] = 0x00;
		reply[7] = 0x01;

		int off = len;
		if (off + 16 > (int)sizeof(reply)) {
			continue;
		}

		reply[off++] = 0xc0;
		reply[off++] = 0x0c;
		reply[off++] = 0x00;
		reply[off++] = 0x01;
		reply[off++] = 0x00;
		reply[off++] = 0x01;
		reply[off++] = 0x00;
		reply[off++] = 0x00;
		reply[off++] = 0x00;
		reply[off++] = 0x1e;
		reply[off++] = 0x00;
		reply[off++] = 0x04;
		reply[off++] = 192;
		reply[off++] = 168;
		reply[off++] = 4;
		reply[off++] = 1;

		zsock_sendto(fd, reply, off, 0, (struct sockaddr *)&peer, peer_len);
	}
}

K_THREAD_DEFINE(dns_tid, 4096, dns_thread, NULL, NULL, NULL, 5, 0, SYS_FOREVER_MS);

void portal_dns_start(void)
{
	k_thread_start(dns_tid);
	LOG_INF("DNS service started");
}
```

## src/portal_dns.h
```c
#ifndef PORTAL_DNS_H
#define PORTAL_DNS_H

void portal_dns_start(void);

#endif
```

## src/portal_http.c
```c
#include "portal_http.h"

#include "credential_store.h"
#include "portal_config.h"
#include "portal_render.h"
#include "wifi_manager.h"

#include <zephyr/kernel.h>
#include <zephyr/logging/log.h>
#include <zephyr/net/socket.h>
#include <zephyr/posix/sys/socket.h>

#include <errno.h>
#include <stdlib.h>
#include <string.h>

LOG_MODULE_REGISTER(portal_http, LOG_LEVEL_INF);

static int open_listener(void)
{
	int fd = zsock_socket(AF_INET, SOCK_STREAM, IPPROTO_TCP);
	if (fd < 0) {
		LOG_ERR("HTTP socket failed errno=%d", errno);
		return -errno;
	}

	int opt = 1;
	zsock_setsockopt(fd, SOL_SOCKET, SO_REUSEADDR, &opt, sizeof(opt));

	struct sockaddr_in addr = {0};
	addr.sin_family = AF_INET;
	addr.sin_port = htons(PORTAL_HTTP_PORT);
	addr.sin_addr.s_addr = htonl(INADDR_ANY);

	if (zsock_bind(fd, (struct sockaddr *)&addr, sizeof(addr)) < 0) {
		int err = errno;
		LOG_ERR("HTTP bind failed errno=%d", err);
		zsock_close(fd);
		return -err;
	}

	if (zsock_listen(fd, 4) < 0) {
		int err = errno;
		LOG_ERR("HTTP listen failed errno=%d", err);
		zsock_close(fd);
		return -err;
	}

	LOG_INF("HTTP portal listener ready on 0.0.0.0:%u", PORTAL_HTTP_PORT);
	return fd;
}

static char page[PORTAL_PAGE_MAX];

static int hex_val(char c)
{
	if (c >= '0' && c <= '9') return c - '0';
	if (c >= 'a' && c <= 'f') return c - 'a' + 10;
	if (c >= 'A' && c <= 'F') return c - 'A' + 10;
	return -1;
}

static void url_decode(const char *in, char *out, size_t out_len)
{
	size_t o = 0;

	if (out_len == 0) {
		return;
	}

	for (size_t i = 0; in[i] != '\0' && o + 1 < out_len; i++) {
		if (in[i] == '+') {
			out[o++] = ' ';
			continue;
		}
		if (in[i] == '%' && in[i + 1] && in[i + 2]) {
			int hi = hex_val(in[i + 1]);
			int lo = hex_val(in[i + 2]);
			if (hi >= 0 && lo >= 0) {
				out[o++] = (char)((hi << 4) | lo);
				i += 2;
				continue;
			}
		}
		out[o++] = in[i];
	}
	out[o] = '\0';
}

static bool get_param(const char *src, const char *name, char *out, size_t out_len)
{
	char needle[32];
	snprintk(needle, sizeof(needle), "%s=", name);

	const char *p = strstr(src, needle);
	if (p == NULL) {
		if (out_len) out[0] = '\0';
		return false;
	}

	p += strlen(needle);
	const char *end = strpbrk(p, "& \r\n");
	size_t len = end ? (size_t)(end - p) : strlen(p);

	char enc[PORTAL_PASS_MAX + PORTAL_SSID_MAX + 8];
	if (len >= sizeof(enc)) {
		len = sizeof(enc) - 1;
	}
	memcpy(enc, p, len);
	enc[len] = '\0';
	url_decode(enc, out, out_len);
	return true;
}

static void send_page(int client, const char *body)
{
	char header[192];
	int body_len = strlen(body);
	int header_len = snprintk(header, sizeof(header),
		"HTTP/1.1 200 OK\r\nContent-Type: text/html; charset=utf-8\r\nCache-Control: no-store\r\nConnection: close\r\nContent-Length: %d\r\n\r\n",
		body_len);

	const char *chunks[] = { header, body };
	int lens[] = { header_len, body_len };

	for (int i = 0; i < ARRAY_SIZE(chunks); i++) {
		const char *data = chunks[i];
		int remaining = lens[i];
		while (remaining > 0) {
			int sent = zsock_send(client, data, remaining, 0);
			if (sent <= 0) {
				LOG_WRN("HTTP send stopped sent=%d errno=%d", sent, errno);
				return;
			}
			data += sent;
			remaining -= sent;
		}
	}
}

static void close_client(int client)
{
	zsock_close(client);
}

static bool method_is(const char *req, const char *method)
{
	size_t len = strlen(method);
	return strncmp(req, method, len) == 0 && req[len] == ' ';
}

static void request_path(const char *req, char *path, size_t path_len)
{
	const char *uri;
	const char *uri_end;
	char uri_buf[160];
	size_t uri_len;

	if (path_len == 0) {
		return;
	}

	strncpy(path, "/", path_len);
	path[path_len - 1] = '\0';

	uri = strchr(req, ' ');
	if (uri == NULL) {
		return;
	}
	uri++;

	uri_end = strchr(uri, ' ');
	if (uri_end == NULL) {
		return;
	}

	uri_len = (size_t)(uri_end - uri);
	if (uri_len >= sizeof(uri_buf)) {
		uri_len = sizeof(uri_buf) - 1;
	}
	memcpy(uri_buf, uri, uri_len);
	uri_buf[uri_len] = '\0';

	if (strncmp(uri_buf, "http://", 7) == 0 || strncmp(uri_buf, "https://", 8) == 0) {
		const char *scheme_end = strstr(uri_buf, "://");
		const char *slash = scheme_end ? strchr(scheme_end + 3, '/') : NULL;
		strncpy(path, slash ? slash : "/", path_len);
	} else if (uri_buf[0] == '/') {
		strncpy(path, uri_buf, path_len);
	}

	path[path_len - 1] = '\0';
}

static bool path_is(const char *path, const char *route)
{
	size_t len = strlen(route);
	return strncmp(path, route, len) == 0 &&
		(path[len] == '\0' || path[len] == '?' || path[len] == '#');
}

static void handle_request(const char *req)
{
	char ssid[PORTAL_SSID_MAX + 1];
	char pass[PORTAL_PASS_MAX + 1];
	char path[160];

	request_path(req, path, sizeof(path));
	LOG_INF("HTTP path: %s", path);

	if (method_is(req, "GET") && path_is(path, "/dashboard")) {
		portal_render_dashboard(page, sizeof(page));
		return;
	}

	if (method_is(req, "GET") && path_is(path, "/") && wifi_manager_sta_connected()) {
		portal_render_dashboard(page, sizeof(page));
		return;
	}

	if (method_is(req, "GET") && path_is(path, "/scan-results")) {
		portal_render_scan_results(page, sizeof(page));
		return;
	}

	if (method_is(req, "GET") && path_is(path, "/scan")) {
		portal_render_scan(page, sizeof(page));
		return;
	}

	if (method_is(req, "GET") && path_is(path, "/manual")) {
		portal_render_manual(page, sizeof(page), NULL);
		return;
	}

	if (method_is(req, "GET") && path_is(path, "/pick")) {
		get_param(req, "ssid", ssid, sizeof(ssid));
		portal_render_pick(page, sizeof(page), ssid, NULL);
		return;
	}

	if (method_is(req, "POST") && path_is(path, "/connect")) {
		get_param(req, "ssid", ssid, sizeof(ssid));
		get_param(req, "pass", pass, sizeof(pass));
		if (ssid[0] == '\0') {
			portal_render_manual(page, sizeof(page), "Enter a Wi-Fi network name.");
			return;
		}
		credential_store_save(ssid, pass);
		int ret = wifi_manager_connect_blocking(ssid, pass);
		if (ret == 0 && wifi_manager_sta_connected()) {
			portal_render_success(page, sizeof(page), ssid);
		} else {
			portal_render_pick(page, sizeof(page), ssid,
					   "Connection failed. Check the password and try again.");
		}
		return;
	}

	portal_render_setup(page, sizeof(page));
}

static int recv_request(int client, char *req, size_t req_len)
{
	int total = 0;
	int content_len = 0;
	char *header_end = NULL;

	while (total < (int)req_len - 1) {
		int n = zsock_recv(client, req + total, req_len - 1 - total, 0);
		if (n <= 0) {
			return total > 0 ? total : n;
		}
		total += n;
		req[total] = '\0';
		if (header_end == NULL) {
			header_end = strstr(req, "\r\n\r\n");
			if (header_end != NULL) {
				const char *content = strstr(req, "Content-Length:");
				if (content != NULL && content < header_end) {
					content += strlen("Content-Length:");
					content_len = atoi(content);
					if (content_len < 0) {
						content_len = 0;
					}
				}
			}
		}
		if (header_end != NULL) {
			int header_len = (int)(header_end - req) + 4;
			if (total >= header_len + content_len) {
				break;
			}
		}
	}

	req[total] = '\0';
	return total;
}

static void http_thread(void)
{
	int fd = open_listener();
	if (fd < 0) {
		LOG_ERR("HTTP server did not start");
		return;
	}

	while (true) {
		int client = zsock_accept(fd, NULL, NULL);
		if (client < 0) {
			LOG_WRN("HTTP accept failed errno=%d", errno);
			k_sleep(K_MSEC(100));
			continue;
		}

		char req[PORTAL_REQ_MAX];
		int n = recv_request(client, req, sizeof(req));
		if (n > 0) {
			handle_request(req);
			send_page(client, page);
		} else {
			LOG_WRN("HTTP empty/failed request n=%d errno=%d", n, errno);
		}

		close_client(client);
	}
}

K_THREAD_DEFINE(http_tid, 8192, http_thread, NULL, NULL, NULL, 5, 0, SYS_FOREVER_MS);

void portal_http_start(void)
{
	k_thread_start(http_tid);
	LOG_INF("HTTP portal service started on port %u", PORTAL_HTTP_PORT);
}
```

## src/portal_http.h
```c
#ifndef PORTAL_HTTP_H
#define PORTAL_HTTP_H

void portal_http_start(void);

#endif
```

## src/portal_mdns.c
```c
#include "portal_mdns.h"

#include "portal_state.h"
#include "wifi_manager.h"

#include <zephyr/kernel.h>
#include <zephyr/logging/log.h>
#include <zephyr/net/net_if.h>
#include <zephyr/net/net_ip.h>
#include <zephyr/net/socket.h>

#include <errno.h>
#include <stdbool.h>
#include <stdint.h>
#include <string.h>

LOG_MODULE_REGISTER(portal_mdns, LOG_LEVEL_INF);

#define MDNS_PORT 5353
#define MDNS_MCAST 0xE00000FBu

static int ascii_lower(int c)
{
	return (c >= 'A' && c <= 'Z') ? (c + ('a' - 'A')) : c;
}

static bool name_equal_ci(const char *a, const char *b)
{
	while (*a && *b) {
		if (ascii_lower((unsigned char)*a) != ascii_lower((unsigned char)*b)) {
			return false;
		}
		a++;
		b++;
	}
	return *a == '\0' && *b == '\0';
}

static bool parse_query_name(const uint8_t *pkt, int len, int *off,
			     char *name, size_t name_len)
{
	int p = *off;
	size_t n = 0;

	if (name_len == 0) {
		return false;
	}

	while (p < len) {
		uint8_t lab_len = pkt[p++];

		if (lab_len == 0) {
			break;
		}
		if ((lab_len & 0xc0) != 0 || p + lab_len > len) {
			return false;
		}
		if (n != 0 && n + 1 < name_len) {
			name[n++] = '.';
		}
		for (uint8_t i = 0; i < lab_len && n + 1 < name_len; i++) {
			name[n++] = pkt[p++];
		}
	}

	if (p + 4 > len) {
		return false;
	}

	name[n] = '\0';
	*off = p;
	return true;
}

static uint16_t get_be16(const uint8_t *p)
{
	return ((uint16_t)p[0] << 8) | p[1];
}

static void put_be16(uint8_t *p, uint16_t v)
{
	p[0] = (uint8_t)(v >> 8);
	p[1] = (uint8_t)v;
}

static void put_be32(uint8_t *p, uint32_t v)
{
	p[0] = (uint8_t)(v >> 24);
	p[1] = (uint8_t)(v >> 16);
	p[2] = (uint8_t)(v >> 8);
	p[3] = (uint8_t)v;
}

static int make_answer(const uint8_t *query, int qlen, uint8_t *reply,
		       size_t reply_len, const struct in_addr *addr)
{
	int off = 12;
	char qname[80];
	char target[80];

	if (qlen < 16 || reply_len < (size_t)qlen + 16) {
		return -EINVAL;
	}
	if (get_be16(&query[4]) == 0) {
		return -EINVAL;
	}
	if (!parse_query_name(query, qlen, &off, qname, sizeof(qname))) {
		return -EINVAL;
	}

	uint16_t qtype = get_be16(&query[off]);
	if (qtype != 1 && qtype != 255) {
		return -ENOENT;
	}
	off += 4;

	snprintk(target, sizeof(target), "%s.local", portal_state_host());
	if (!name_equal_ci(qname, target)) {
		return -ENOENT;
	}

	memcpy(reply, query, off);
	reply[2] = 0x84;
	reply[3] = 0x00;
	put_be16(&reply[6], 1);
	put_be16(&reply[8], 0);
	put_be16(&reply[10], 0);

	if ((size_t)off + 16 > reply_len) {
		return -ENOBUFS;
	}

	reply[off++] = 0xc0;
	reply[off++] = 0x0c;
	put_be16(&reply[off], 1); off += 2;
	put_be16(&reply[off], 0x8001); off += 2;
	put_be32(&reply[off], 120); off += 4;
	put_be16(&reply[off], 4); off += 2;
	memcpy(&reply[off], &addr->s_addr, 4); off += 4;

	LOG_INF("mDNS answer: %s -> %s", target, wifi_manager_sta_connected() ? "STA IP" : "not connected");
	return off;
}

static int open_mdns_socket(void)
{
	struct net_if *iface = net_if_get_wifi_sta();
	struct net_sockaddr_in bind_addr = {0};
	struct net_ip_mreqn mreq = {0};
	int fd;
	int on = 1;
	int ttl = 255;

	if (iface == NULL) {
		return -ENODEV;
	}

	fd = zsock_socket(NET_AF_INET, NET_SOCK_DGRAM, NET_IPPROTO_UDP);
	if (fd < 0) {
		return -errno;
	}

	zsock_setsockopt(fd, ZSOCK_SOL_SOCKET, ZSOCK_SO_REUSEADDR, &on, sizeof(on));
	zsock_setsockopt(fd, ZSOCK_SOL_SOCKET, ZSOCK_SO_REUSEPORT, &on, sizeof(on));

	mreq.imr_ifindex = net_if_get_by_iface(iface);
	mreq.imr_multiaddr.s_addr = net_htonl(MDNS_MCAST);
	if (zsock_setsockopt(fd, NET_IPPROTO_IP, ZSOCK_IP_ADD_MEMBERSHIP,
			      &mreq, sizeof(mreq)) < 0 && errno != EALREADY) {
		int err = errno;
		zsock_close(fd);
		return -err;
	}

	zsock_setsockopt(fd, NET_IPPROTO_IP, ZSOCK_IP_MULTICAST_LOOP, &on, sizeof(on));
	zsock_setsockopt(fd, NET_IPPROTO_IP, ZSOCK_IP_MULTICAST_IF, &mreq, sizeof(mreq));
	zsock_setsockopt(fd, NET_IPPROTO_IP, ZSOCK_IP_MULTICAST_TTL, &ttl, sizeof(ttl));
	zsock_setsockopt(fd, NET_IPPROTO_IP, ZSOCK_IP_TTL, &ttl, sizeof(ttl));

	bind_addr.sin_family = NET_AF_INET;
	bind_addr.sin_port = net_htons(MDNS_PORT);
	bind_addr.sin_addr.s_addr = net_htonl(INADDR_ANY);

	if (zsock_bind(fd, (struct sockaddr *)&bind_addr, sizeof(bind_addr)) < 0) {
		int err = errno;
		zsock_close(fd);
		return -err;
	}

	LOG_INF("mDNS responder listening for %s.local on UDP 5353", portal_state_host());
	return fd;
}

static void mdns_thread(void *p1, void *p2, void *p3)
{
	ARG_UNUSED(p1);
	ARG_UNUSED(p2);
	ARG_UNUSED(p3);

	while (true) {
		char ip[NET_IPV4_ADDR_LEN];
		struct in_addr local_addr;

		wifi_manager_local_ip(ip, sizeof(ip));
		if (!wifi_manager_sta_connected() || ip[0] == '\0' ||
		    net_addr_pton(AF_INET, ip, &local_addr) != 0) {
			k_sleep(K_SECONDS(1));
			continue;
		}

		int fd = open_mdns_socket();
		if (fd < 0) {
			LOG_WRN("mDNS socket start failed: %d", fd);
			k_sleep(K_SECONDS(2));
			continue;
		}

		while (wifi_manager_sta_connected()) {
			uint8_t query[512];
			uint8_t reply[576];
			struct sockaddr_in peer;
			socklen_t peer_len = sizeof(peer);
			int len = zsock_recvfrom(fd, query, sizeof(query), 0,
						 (struct sockaddr *)&peer, &peer_len);
			if (len <= 0) {
				continue;
			}

			int out_len = make_answer(query, len, reply, sizeof(reply), &local_addr);
			if (out_len <= 0) {
				continue;
			}

			zsock_sendto(fd, reply, out_len, 0,
				     (struct sockaddr *)&peer, peer_len);

			struct sockaddr_in mcast = {0};
			mcast.sin_family = AF_INET;
			mcast.sin_port = htons(MDNS_PORT);
			mcast.sin_addr.s_addr = htonl(MDNS_MCAST);
			zsock_sendto(fd, reply, out_len, 0,
				     (struct sockaddr *)&mcast, sizeof(mcast));
		}

		zsock_close(fd);
	}
}

K_THREAD_DEFINE(mdns_tid, 4096, mdns_thread, NULL, NULL, NULL, 6, 0, SYS_FOREVER_MS);

void portal_mdns_start(void)
{
	k_thread_start(mdns_tid);
	LOG_INF("mDNS service thread started");
}
```

## src/portal_mdns.h
```c
#ifndef PORTAL_MDNS_H
#define PORTAL_MDNS_H

void portal_mdns_start(void);

#endif
```

## src/portal_render.c
```c
#include "portal_render.h"

#include "credential_store.h"
#include "portal_config.h"
#include "portal_state.h"
#include "wifi_manager.h"

#include <zephyr/net/net_ip.h>

#include <errno.h>
#include <stdarg.h>
#include <stdio.h>
#include <string.h>

static void page_append(char *buf, size_t cap, size_t *off, const char *fmt, ...)
{
	if (*off >= cap) {
		return;
	}

	va_list args;
	va_start(args, fmt);
	int n = vsnprintf(buf + *off, cap - *off, fmt, args);
	va_end(args);

	if (n < 0) {
		return;
	}

	if ((size_t)n >= cap - *off) {
		*off = cap - 1;
	} else {
		*off += (size_t)n;
	}
}

static void html_escape(const char *in, char *out, size_t out_len)
{
	size_t o = 0;

	if (out_len == 0) {
		return;
	}

	for (size_t i = 0; in[i] != '\0' && o + 1 < out_len; i++) {
		const char *rep = NULL;

		switch (in[i]) {
		case '&': rep = "&amp;"; break;
		case '<': rep = "&lt;"; break;
		case '>': rep = "&gt;"; break;
		case '"': rep = "&quot;"; break;
		case '\'': rep = "&#39;"; break;
		default: break;
		}

		if (rep != NULL) {
			size_t rlen = strlen(rep);
			if (o + rlen >= out_len) {
				break;
			}
			memcpy(out + o, rep, rlen);
			o += rlen;
		} else {
			out[o++] = in[i];
		}
	}

	out[o] = '\0';
}

static int signal_percent(int rssi)
{
	int pct = 2 * (rssi + 100);

	if (pct < 0) {
		pct = 0;
	}
	if (pct > 100) {
		pct = 100;
	}

	return pct;
}

static const char *signal_label(int rssi)
{
	if (rssi >= -55) {
		return "Excellent";
	}
	if (rssi >= -67) {
		return "Good";
	}
	if (rssi >= -75) {
		return "Fair";
	}
	return "Weak";
}

static void page_header(char *buf, size_t cap, size_t *off, const char *title)
{
	page_append(buf, cap, off,
		"<!doctype html><html><head><meta charset='utf-8'>"
		"<meta name='viewport' content='width=device-width,initial-scale=1'>"
		"<title>%s</title>"
		"<style>body{font-family:system-ui,-apple-system,Segoe UI,sans-serif;background:radial-gradient(circle at top left,#00b8f024,transparent 30rem),radial-gradient(circle at bottom right,#00d97e12,transparent 28rem),#050b16;color:#d8e6f7;margin:0;padding:18px}"
		".wrap{max-width:480px;margin:auto}.card{background:linear-gradient(180deg,#101d32f5,#0d1727f5);border:1px solid #1b2d4a;border-radius:17px;padding:18px;margin:0 0 14px;box-shadow:0 18px 50px #0005}"
		"h1{font-size:22px;margin:0 0 4px;color:white}h2{font-size:18px;margin:0 0 8px;color:white}.muted,p{color:#7890ad;line-height:1.45}.title{font-size:11px;text-transform:uppercase;letter-spacing:.12em;color:#7890ad;font-weight:900;margin-bottom:10px}"
		"button,.btn,input{display:block;width:100%%;box-sizing:border-box;border-radius:11px;border:0;padding:14px;margin:8px 0;font:inherit;font-weight:800;text-decoration:none;text-align:center}"
		"button,.primary{background:linear-gradient(135deg,#00b8f0,#46d8ff);color:#001018}.ghost{background:#ffffff05;color:#9fb0c8;border:1px solid #1b2d4a}.danger{background:#ff5c5c14;color:#ff5c5c;border:1px solid #ff5c5c3d}"
		"input{background:#07101f;color:#d8e6f7;border:1px solid #1b2d4a;font-weight:500}.row{display:flex;justify-content:space-between;border-bottom:1px solid #fff1;padding:6px 0;gap:12px}.good{color:#00d97e}.bad{color:#ff5c5c}.net{text-align:left;background:#07101f;color:#d8e6f7;border:1px solid #1b2d4a}.bar{height:10px;border-radius:99px;background:#26344f;overflow:hidden}.fill{height:100%%;border-radius:99px;background:linear-gradient(90deg,#00b8f0,#00d97e)}"
		".steps{display:flex;align-items:center;margin:12px 0}.dot{width:28px;height:28px;border-radius:50%%;display:flex;align-items:center;justify-content:center;border:2px solid #274262;color:#7890ad;font-weight:900}.dot.on{border-color:#00b8f0;color:#00b8f0;background:#00b8f014}.dot.done{border-color:#00d97e;background:#00d97e;color:#00140b}.line{flex:1;height:2px;background:#274262}.line.done{background:#00d97e}.msg{border:1px solid #1b2d4a;border-radius:12px;padding:12px;background:#081325;color:#9fb0c8}.ip{font-size:20px;color:#00d97e;font-weight:900;word-break:break-all}.host{font-size:18px;color:#fff;font-weight:900;word-break:break-all}.small{font-size:12px;color:#7890ad}.spin{width:52px;height:52px;border-radius:50%%;border:4px solid #ffffff14;border-top-color:#00b8f0;border-right-color:#00d97e;animation:spin .85s linear infinite;margin:18px auto}@keyframes spin{to{transform:rotate(360deg)}}"
		"</style></head><body><div class='wrap'><div class='card'><h1>%s</h1><div class='muted'>Wi-Fi setup</div></div>",
		title,
		PORTAL_PRODUCT_TITLE);
}

static void page_footer(char *buf, size_t cap, size_t *off)
{
	page_append(buf, cap, off, "</div></body></html>");
}

static void auto_redirect(char *buf, size_t cap, size_t *off, const char *url, int delay_ms)
{
	page_append(buf, cap, off,
		"<script>setTimeout(function(){window.location.replace('%s');},%d);</script>",
		url, delay_ms);
}

static void status_card(char *buf, size_t cap, size_t *off)
{
	page_append(buf, cap, off,
		"<div class='card'><div class='title'>Device Status</div>"
		"<div class='row'><span>Setup Wi-Fi</span><b>%s</b></div>"
		"<div class='row'><span>Setup IP</span><b>%s</b></div>"
		"<div class='row'><span>Local Wi-Fi</span><b class='%s'>%s</b></div>"
		"<div class='row'><span>Saved network</span><b>%s</b></div>",
		portal_state_ap_ssid(), PORTAL_AP_IP,
		wifi_manager_sta_connected() ? "good" : "bad",
		wifi_manager_sta_connected() ? "connected" : "not connected",
		credential_store_has_ssid() ? credential_store_ssid() : "none");

	if (wifi_manager_sta_connected()) {
		page_append(buf, cap, off,
			"<div class='row'><span>Dashboard</span><b class='good'>%s.local</b></div>",
			portal_state_host());
	}

	page_append(buf, cap, off, "</div>");
}

static void steps(char *buf, size_t cap, size_t *off, int step)
{
	page_append(buf, cap, off,
		"<div class='steps'><div class='dot %s'>1</div><div class='line %s'></div>"
		"<div class='dot %s'>2</div><div class='line %s'></div><div class='dot %s'>3</div></div>",
		step == 1 ? "on" : "done",
		step >= 2 ? "done" : "",
		step == 2 ? "on" : (step > 2 ? "done" : ""),
		step >= 3 ? "done" : "",
		step == 3 ? "done" : "");
}

static void bottom_actions(char *buf, size_t cap, size_t *off)
{
	if (!wifi_manager_sta_connected() && !credential_store_has_ssid()) {
		return;
	}

	page_append(buf, cap, off,
		"<div class='card'><div class='title'>Settings</div><p class='muted'>Only use this if you want to change Wi-Fi.</p>"
		"<form method='POST' action='/forget'><button class='danger'>Reset saved Wi-Fi</button></form></div>");
}

void portal_render_setup(char *buf, size_t cap)
{
	size_t off = 0;

	page_header(buf, cap, &off, "Setup");
	status_card(buf, cap, &off);
	steps(buf, cap, &off, 1);
	page_append(buf, cap, &off,
		"<div class='card'><div class='title'>Step 1 of 3</div><h2>Choose Wi-Fi</h2>"
		"<p>Pick the Wi-Fi network for this sensor.</p>"
		"<form method='GET' action='/scan'><button>Scan networks</button></form>"
		"<a class='btn ghost' href='/manual'>Type network manually</a></div>");
	bottom_actions(buf, cap, &off);
	page_footer(buf, cap, &off);
}

void portal_render_manual(char *buf, size_t cap, const char *error)
{
	size_t off = 0;

	page_header(buf, cap, &off, "Manual Wi-Fi");
	status_card(buf, cap, &off);
	steps(buf, cap, &off, 2);
	page_append(buf, cap, &off,
		"<div class='card'><div class='title'>Step 2 of 3</div><h2>Enter Wi-Fi</h2>"
		"<p>Type the network name and password.</p>");
	if (error != NULL && error[0]) {
		page_append(buf, cap, &off, "<p class='bad'>%s</p>", error);
	}
	page_append(buf, cap, &off,
		"<form method='POST' action='/connect'><input name='ssid' placeholder='Wi-Fi network name' autocomplete='off'>"
		"<input name='pass' type='password' placeholder='Wi-Fi password' autocomplete='current-password'>"
		"<button>Connect</button></form><a class='btn ghost' href='/'>Back</a></div>");
	bottom_actions(buf, cap, &off);
	page_footer(buf, cap, &off);
}

void portal_render_scan(char *buf, size_t cap)
{
	int ret = wifi_manager_scan_start();
	size_t off = 0;

	page_header(buf, cap, &off, "Scanning");
	auto_redirect(buf, cap, &off, "/scan-results", 900);
	status_card(buf, cap, &off);
	steps(buf, cap, &off, 1);
	page_append(buf, cap, &off,
		"<div class='card'><div class='title'>Step 1 of 3</div><h2>Scanning networks</h2>"
		"<div class='spin'></div>");

	if (ret == -EALREADY) {
		page_append(buf, cap, &off,
			"<p>A scan is already running. Results will open automatically.</p>");
	} else if (ret != 0) {
		page_append(buf, cap, &off,
			"<p class='bad'>Could not start Wi-Fi scan (%d).</p>", ret);
	} else {
		page_append(buf, cap, &off,
			"<p>Refreshing the network list. Results will open automatically.</p>");
	}

	page_append(buf, cap, &off,
		"<a class='btn ghost' href='/manual'>Type network manually</a></div>");
	bottom_actions(buf, cap, &off);
	page_footer(buf, cap, &off);
}

void portal_render_scan_results(char *buf, size_t cap)
{
	enum portal_scan_state state = wifi_manager_scan_state();
	int scan_count = wifi_manager_scan_count();
	const struct portal_net *scan_results = wifi_manager_scan_results();
	size_t off = 0;

	page_header(buf, cap, &off, "Scan Results");
	status_card(buf, cap, &off);
	steps(buf, cap, &off, 1);
	page_append(buf, cap, &off,
		"<div class='card'><div class='title'>Step 1 of 3</div><h2>Choose Wi-Fi</h2>");

	if (state == PORTAL_SCAN_IDLE) {
		page_append(buf, cap, &off,
			"<p>No scan has run yet.</p>"
			"<form method='GET' action='/scan'><button>Scan networks</button></form>"
			"<a class='btn ghost' href='/manual'>Type network manually</a></div>");
		bottom_actions(buf, cap, &off);
		page_footer(buf, cap, &off);
		return;
	}

	if (state == PORTAL_SCAN_RUNNING) {
		auto_redirect(buf, cap, &off, "/scan-results", 2500);
		page_append(buf, cap, &off,
			"<div class='spin'></div><p>Still scanning. This page will refresh automatically.</p>"
			"<a class='btn ghost' href='/manual'>Type network manually</a></div>");
		bottom_actions(buf, cap, &off);
		page_footer(buf, cap, &off);
		return;
	}

	if (state == PORTAL_SCAN_FAILED) {
		page_append(buf, cap, &off,
			"<p class='bad'>Wi-Fi scan failed (%d).</p>"
			"<form method='GET' action='/scan'><button>Scan again</button></form>"
			"<a class='btn ghost' href='/manual'>Type network manually</a></div>",
			wifi_manager_scan_last_error());
		bottom_actions(buf, cap, &off);
		page_footer(buf, cap, &off);
		return;
	}

	if (scan_count <= 0) {
		page_append(buf, cap, &off,
			"<p class='bad'>No networks found.</p>"
			"<form method='GET' action='/scan'><button>Scan again</button></form>"
			"<a class='btn ghost' href='/manual'>Type network manually</a></div>");
		bottom_actions(buf, cap, &off);
		page_footer(buf, cap, &off);
		return;
	}

	page_append(buf, cap, &off, "<p>Tap your network.</p>");
	for (int i = 0; i < scan_count; i++) {
		char esc[96];
		html_escape(scan_results[i].ssid, esc, sizeof(esc));
		int pct = signal_percent(scan_results[i].rssi);
		page_append(buf, cap, &off,
			"<form method='GET' action='/pick'><input type='hidden' name='ssid' value='%s'>"
			"<button class='net'><div style='display:flex;justify-content:space-between;gap:10px'><b>%s</b><span>%s</span></div>"
			"<div class='muted' style='display:flex;justify-content:space-between'><span>%s</span><span>%d dBm</span></div>"
			"<div class='bar'><div class='fill' style='width:%d%%'></div></div></button></form>",
			esc, esc, scan_results[i].secure ? "&#128274;" : "&nbsp;",
			signal_label(scan_results[i].rssi), scan_results[i].rssi, pct);
	}

	page_append(buf, cap, &off,
		"<hr><form method='GET' action='/scan'><button class='ghost'>Scan again</button></form>"
		"<a class='btn ghost' href='/manual'>Type network manually</a></div>");
	bottom_actions(buf, cap, &off);
	page_footer(buf, cap, &off);
}

void portal_render_pick(char *buf, size_t cap, const char *ssid,
			const char *error)
{
	char esc[96];
	html_escape(ssid, esc, sizeof(esc));

	size_t off = 0;
	page_header(buf, cap, &off, "Password");
	status_card(buf, cap, &off);
	steps(buf, cap, &off, 2);
	page_append(buf, cap, &off,
		"<div class='card'><div class='title'>Step 2 of 3</div><h2>Enter password</h2><p><b style='color:white'>%s</b></p>",
		esc);
	if (error != NULL && error[0]) {
		page_append(buf, cap, &off, "<p class='bad'>%s</p>", error);
	}
	page_append(buf, cap, &off,
		"<form method='POST' action='/connect'><input type='hidden' name='ssid' value='%s'>"
		"<input name='pass' type='password' placeholder='Wi-Fi password'>"
		"<button>Connect</button></form><a class='btn ghost' href='/scan'>Choose different network</a></div>",
		esc);
	bottom_actions(buf, cap, &off);
	page_footer(buf, cap, &off);
}

void portal_render_success(char *buf, size_t cap, const char *ssid)
{
	char esc[96];
	char ip[NET_IPV4_ADDR_LEN];
	html_escape(ssid, esc, sizeof(esc));
	wifi_manager_local_ip(ip, sizeof(ip));

	size_t off = 0;
	page_header(buf, cap, &off, "Connected");
	status_card(buf, cap, &off);
	steps(buf, cap, &off, 3);
	page_append(buf, cap, &off,
		"<div class='card'><div class='title'>Step 3 of 3</div><h2>Connected</h2>"
		"<p>The device joined <b style='color:white'>%s</b>.</p>"
		"<p>Dashboard:</p><div class='host'>%s</div><p class='small'>Backup IP: %s</p>"
		"<p>Copy the dashboard address, then close the setup Wi-Fi.</p>"
		"<form method='POST' action='/handoff'><button>Finish setup and close setup Wi-Fi</button></form></div>",
		esc, portal_state_dashboard_url(), ip[0] ? ip : "check serial");
	bottom_actions(buf, cap, &off);
	page_footer(buf, cap, &off);
}

void portal_render_handoff(char *buf, size_t cap)
{
	size_t off = 0;

	page_header(buf, cap, &off, "Finish setup");
	page_append(buf, cap, &off,
		"<div class='card'><div class='title'>Finish setup</div><h2>Setup Wi-Fi closing</h2>"
		"<p class='msg'>The setup Wi-Fi is turning off. Captive portal browsers can block automatic dashboard redirects, so this page will not redirect.</p>"
		"<p>Copy the dashboard URL below. When the setup Wi-Fi disconnects, reconnect to your normal Wi-Fi and paste the URL into a normal browser tab.</p>"
		"<p>Dashboard:</p><input id='dashUrl' readonly value='%s' onclick='this.select()'>"
		"<button type='button' onclick='copyDashUrl()'>Copy dashboard URL</button></div>"
		"<script>function copyDashUrl(){var i=document.getElementById('dashUrl');if(!i)return;i.select();i.setSelectionRange(0,9999);if(navigator.clipboard){navigator.clipboard.writeText(i.value);}else{document.execCommand('copy');}}</script>",
		portal_state_dashboard_url());
	page_footer(buf, cap, &off);
}

void portal_render_dashboard(char *buf, size_t cap)
{
	size_t off = 0;

	page_header(buf, cap, &off, "Dashboard");
	status_card(buf, cap, &off);
	page_append(buf, cap, &off,
		"<div class='card'><div class='title'>Dashboard</div><h2>Device ready</h2>"
		"<p class='good'>Connected on local Wi-Fi.</p><p>Sensor data will appear here next.</p></div>");
	bottom_actions(buf, cap, &off);
	page_footer(buf, cap, &off);
}

void portal_render_reset(char *buf, size_t cap)
{
	size_t off = 0;

	page_header(buf, cap, &off, "Reset");
	page_append(buf, cap, &off,
		"<div class='card'><div class='title'>Reset Wi-Fi</div><h2>Saved Wi-Fi cleared</h2>"
		"<div class='spin'></div><p>Reconnect to <b style='color:white'>%s</b>, then open <b>%s</b>.</p></div>",
		portal_state_ap_ssid(), PORTAL_AP_IP);
	page_footer(buf, cap, &off);
}
```

## src/portal_render.h
```c
#ifndef PORTAL_RENDER_H
#define PORTAL_RENDER_H

#include <stddef.h>

void portal_render_setup(char *buf, size_t cap);
void portal_render_manual(char *buf, size_t cap, const char *error);
void portal_render_scan(char *buf, size_t cap);
void portal_render_scan_results(char *buf, size_t cap);
void portal_render_pick(char *buf, size_t cap, const char *ssid,
			const char *error);
void portal_render_success(char *buf, size_t cap, const char *ssid);
void portal_render_handoff(char *buf, size_t cap);
void portal_render_dashboard(char *buf, size_t cap);
void portal_render_reset(char *buf, size_t cap);

#endif
```

## src/portal_state.c
```c
#include "portal_state.h"

#include "portal_config.h"

#include <zephyr/drivers/hwinfo.h>
#include <zephyr/kernel.h>

#include <stdio.h>
#include <string.h>

static char device_host[PORTAL_HOST_MAX];
static char ap_ssid[PORTAL_SSID_MAX + 1];
static char dashboard_url[PORTAL_URL_MAX];
static bool handoff_pending;
static bool reboot_pending;

void portal_state_init(void)
{
	uint8_t id[16];
	uint8_t suffix[3];
	ssize_t id_len = hwinfo_get_device_id(id, sizeof(id));

	if (id_len >= sizeof(suffix)) {
		const uint8_t *addr = id + id_len - sizeof(suffix);
		memcpy(suffix, addr, sizeof(suffix));
	} else {
		uint32_t fallback = k_cycle_get_32();

		suffix[0] = (uint8_t)(fallback >> 16);
		suffix[1] = (uint8_t)(fallback >> 8);
		suffix[2] = (uint8_t)fallback;
	}

	snprintk(device_host, sizeof(device_host), "%s-%02x%02x%02x",
		 PORTAL_HOST_PREFIX, suffix[0], suffix[1], suffix[2]);
	snprintk(ap_ssid, sizeof(ap_ssid), "%s-%02X%02X%02X",
		 PORTAL_AP_SSID_PREFIX, suffix[0], suffix[1], suffix[2]);
	snprintk(dashboard_url, sizeof(dashboard_url), "http://%s.local/",
		 device_host);
}

const char *portal_state_host(void)
{
	return device_host;
}

const char *portal_state_ap_ssid(void)
{
	return ap_ssid;
}

const char *portal_state_dashboard_url(void)
{
	return dashboard_url;
}

void portal_state_request_handoff(void)
{
	handoff_pending = true;
}

bool portal_state_take_handoff_request(void)
{
	if (!handoff_pending) {
		return false;
	}

	handoff_pending = false;
	return true;
}

void portal_state_request_reboot(void)
{
	reboot_pending = true;
}

bool portal_state_take_reboot_request(void)
{
	if (!reboot_pending) {
		return false;
	}

	reboot_pending = false;
	return true;
}
```
